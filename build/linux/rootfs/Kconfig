## build/linux/rootfs/Kconfig
```kconfig
mainmenu "linux/rootfs Configuration"
config ARCH_ARM
	bool
	default y
menu "Filesystem Packages"
source /opt/petalinux/petalinux-v2014.4-final/components/packages-repo/Kconfig.defaults
if ROOTFS_ADVANCED_MODE
choice
	prompt "packages-repo"
config ROOTFS_COMPONENT_PACKAGES__REPO_NAME_PLNX__REPO
	bool "plnx-repo"
endchoice
if ROOTFS_COMPONENT_PACKAGES__REPO_NAME_PLNX__REPO
source /opt/petalinux/petalinux-v2014.4-final/components//packages-repo/plnx-repo/Kconfig
endif
endif
if !ROOTFS_ADVANCED_MODE
config ROOTFS_COMPONENT_PACKAGES__REPO_NAME_PLNX__REPO
	bool
	default y
source /opt/petalinux/petalinux-v2014.4-final/components/packages-repo/plnx-repo/Kconfig
endif
endmenu
menu "Libs"
endmenu
menu "Apps"
menuconfig ROOTFS_COMPONENT_APPS_NAME_FWUPGRADE
	bool "fwupgrade"
source /opt/petalinux/petalinux-v2014.4-final/components//apps/fwupgrade/Kconfig
menuconfig ROOTFS_COMPONENT_APPS_NAME_GPIO__DEMO
	bool "gpio-demo"
source /opt/petalinux/petalinux-v2014.4-final/components//apps/gpio-demo/Kconfig
menuconfig ROOTFS_COMPONENT_APPS_NAME_LATENCYSTAT
	bool "latencystat"
source /opt/petalinux/petalinux-v2014.4-final/components//apps/latencystat/Kconfig
menuconfig ROOTFS_COMPONENT_APPS_NAME_PEEKPOKE
	bool "peekpoke"
source /opt/petalinux/petalinux-v2014.4-final/components//apps/peekpoke/Kconfig
menuconfig ROOTFS_COMPONENT_APPS_NAME_SNES
	bool "snes"
source /home/steven/Desktop/LINUX_SNES/components//apps/snes/Kconfig
menuconfig ROOTFS_COMPONENT_APPS_NAME_UWEB
	bool "uWeb"
source /opt/petalinux/petalinux-v2014.4-final/components//apps/uWeb/Kconfig
endmenu
menu "Modules"
endmenu
menu "PetaLinux RootFS Settings"
config ROOTFS_ROOT_PASSWD
	string "Root password"
	default ""
	help
	  Default login password for the 'root' user, on your PetaLinux system.

comment "Service configuration"
config ROOTFS_BUSYBOX_INETD_FTPD
	bool "Enable busybox FTPD with inetd service"
	select ROOTFS_PACKAGES_BUSYBOX_INETD
	default 'y'
	help
	 Select this option to enable busybox ftpd with inetd service and
	 run it on startup.

config ROOTFS_BUSYBOX_INETD_TELNETD
	bool "Enable busybox TELNETD with inetd service"
	select ROOTFS_PACKAGES_BUSYBOX_INETD
	default 'y'
	help
	 Select this option to enable busybox telnetd with inetd
	 service and run it on startup.
endmenu

#############################################################################

menu "Debugging"

config USER_DEBUG
	bool "build debugable applications"
	help
	 Build all user application with debug symbols and reduced optimisation
	 levels.  See also debug build option in force library building.  Withou
	 this option debug symbols are still included, however the optimisation
	 level is increased and this can lead to problematic debugging.

endmenu
```

## build/linux/rootfs/apps/uWeb/Kconfig
```kconfig
###############################################################################
# Please modify this file if you want to configure your own application.
# You can uncommon and/or change the following Kconfig elements.
###############################################################################

if APPS_UWEB

config APPS_UWEB_DEMO_INETD
	bool "Run uWeb from inetd"
	help
	 By default, uWeb will run as a server listening on port 80.
	 Chose this option to run the uWeb demo as an inetd service instead,
	 for example if you are low on memory and don't wish the server to be
	 running permanently.

endif
```

## build/linux/rootfs/packages-repo/Kconfig.defaults
```kconfig
config ROOTFS_ADVANCED_MODE
	bool "Advanced Package Selection"
	def_bool n
	help
	 Enable advanced package selection and management.

config ROOTFS_BASE_SYSTEM_DEFAULT
	bool "base-system-default"
	select ROOTFS_PACKAGES_INIT_IFUPDOWN
	select ROOTFS_PACKAGES_TINYLOGIN
	select ROOTFS_PACKAGES_BUSYBOX
	select ROOTFS_PACKAGES_MODUTILS_INITSCRIPTS
	select ROOTFS_PACKAGES_INITSCRIPTS
	select ROOTFS_PACKAGES_BUSYBOX_MDEV
	select ROOTFS_PACKAGES_SYSVINIT
	select ROOTFS_PACKAGES_NETBASE
	select ROOTFS_PACKAGES_BASE_FILES
	select ROOTFS_PACKAGES_BASE_PASSWD
	select ROOTFS_PACKAGES_BUSYBOX_UDHCPC
	default y
	help
	 Base System Image
```
